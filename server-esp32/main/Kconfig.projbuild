## server-esp32/main/Kconfig.projbuild
```kconfig
menu "Prompt Relay Configuration"

    config WIFI_SSID
        string "WiFi SSID"
        default ""
        help
            SSID of the WiFi network to connect to.

    config WIFI_PASSWORD
        string "WiFi Password"
        default ""
        help
            Password for the WiFi network.

endmenu
```

## server-esp32/sdkconfig.defaults
```kconfig
# Flash size
CONFIG_ESPTOOLPY_FLASHSIZE_4MB=y

# Partition table
CONFIG_PARTITION_TABLE_CUSTOM=y
CONFIG_PARTITION_TABLE_CUSTOM_FILENAME="partitions.csv"

# C++ exceptions (required by M5Unified)
CONFIG_COMPILER_CXX_EXCEPTIONS=y

# HTTP server
CONFIG_HTTPD_MAX_REQ_HDR_LEN=1024
CONFIG_HTTPD_MAX_URI_LEN=512

# WiFi
CONFIG_WIFI_SSID=""
CONFIG_WIFI_PASSWORD=""

# Stack sizes
CONFIG_ESP_MAIN_TASK_STACK_SIZE=8192

# Log level
CONFIG_LOG_DEFAULT_LEVEL_INFO=y
```
